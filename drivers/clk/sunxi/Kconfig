## drivers/clk/sunxi/Kconfig
```kconfig
config CLK_SUN8I_APB0
	def_bool MACH_SUN9I || MACH_SUN8I
 
config CLK_SUN9I_CPUS
	def_bool MACH_SUN9I || MACH_SUN8I
```

## drivers/gpu/drm/sunxi/Kconfig
```kconfig
#
# Allwinner Video configuration
#

config DRM_SUNXI
	tristate "DRM Support for Allwinner Video"
	depends on DRM && ARCH_SUNXI
	depends on OF
	select DRM_KMS_HELPER
	select DRM_KMS_CMA_HELPER
	select DRM_GEM_CMA_HELPER
	help
	  Choose this option if you have a Allwinner chipset.

config DRM_SUNXI_DE2
	tristate "Support for Allwinner Video with DE2 interface"
	depends on DRM_SUNXI
	help
	  Choose this option if your Allwinner chipset has the DE2 interface
	  as the H3.
```
